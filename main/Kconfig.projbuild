## main/Kconfig.projbuild
```kconfig
menu "Application Configuration"


choice AGENT_ROLE
    bool "Choose agent's role"
    default AGENT_ROLE_RELAY
    help
        Pick between Base Station, Relay, and Explorer.

config AGENT_ROLE_BASE
   bool "Base Station agent"
   help
        Directly connect with the WIFI Access Point.

config AGENT_ROLE_RELAY
   bool "Relay agent"
   help
        Relay image stream from Explorer to Base Station.

config AGENT_ROLE_EXPLORER
   bool "Explorer agent"
   help
        Transmit image stream over the mesh to Base Station agent.

endchoice

config AGENT_NAME
    string
    default "BASE" if AGENT_ROLE_BASE
    default "RELAY" if AGENT_ROLE_RELAY
    default "EXPLORER" if AGENT_ROLE_EXPLORER

config DEVICE_TYPE
    int
    # In mwifi.h ...
    # MWIFI_MESH_ROOT is defined as 1
    # MWIFI_MESH_NODE is defined as 
    default 1 if AGENT_ROLE_BASE
    default 2 if AGENT_ROLE_RELAY
    default 2 if AGENT_ROLE_EXPLORER

config WIFI_SSID
    string "WIFI SSID"
    default "wifi_ssid"

config WIFI_PASSWORD
    string "WIFI Password"
    default "secret_password"

config MESH_ID
    string "Mesh ID"
        default "123456"
        help
            The maximum length is 6 bytes. Mesh network identification,
            Nodes with the same mesh ID can, communicate with each other.

config MESH_CHANNEL
    int "Mesh network channel"
    range 1 14
    default 13
    help
        Mesh network channel.
endmenu
```
